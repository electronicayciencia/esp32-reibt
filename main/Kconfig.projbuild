## main/Kconfig.projbuild
```kconfig
menu "REI-BT Configuration"
    config REIBT_I2S_LRCK_PIN
        int "I2S LRCK (WSEL) GPIO"
        default 16
        help
            GPIO number to use for I2S LRCK(WS) Driver.

    config REIBT_I2S_DATA_PIN
        int "I2S DATA (DIN) GPIO"
        default 17
        help
            GPIO number to use for I2S Data Driver.

    config REIBT_I2S_BCK_PIN
        int "I2S BCK (BLCK) GPIO"
        default 21
        help
            GPIO number to use for I2S BCK Driver.

    config REIBT_LOCAL_DEVICE_NAME
        string "Local Device Name"
        default "REI-BT"
        help
            Use this option to set local device name.

    config REIBT_FIXED_PIN
        string "Fixed PIN for Bluetooth Pairing"
        default "1234"
        help
            Enter a numeric PIN code (1 to 16 digits) for Bluetooth pairing.
            Only digits 0-9 are allowed.
endmenu
```
